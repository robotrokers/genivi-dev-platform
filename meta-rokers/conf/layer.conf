## meta-rokers/conf/layer.conf
```bitbake
# We have a conf and classes directory, add to BBPATH
BBPATH .= ":${LAYERDIR}"

# We have recipes-* directories, add to BBFILES
BBFILES += "${LAYERDIR}/recipes-*/*/*.bb \
	${LAYERDIR}/recipes-*/*/*.bbappend"

BBFILE_COLLECTIONS += "rokers"
BBFILE_PATTERN_rokers = "^${LAYERDIR}/"
BBFILE_PRIORITY_rokers = "6"

DISTRO_NAME = "Yocto Rokers Distro"
DISTRO_VERSION = "0.0.1"
```
